#include "ssd1306.h"
#include "delay.h"
#include <string.h>

/* ===================== 软件 I2C（PB6=SCL, PB7=SDA） ===================== */
static void I2C_Delay(void)  { Delay_us(3); }          // 约 150kHz，稳即可

static void SCL_Set(uint8_t v) { if (v) GPIO_SetBits(SSD1306_I2C_PORT, SSD1306_SCL_PIN);
                                 else   GPIO_ResetBits(SSD1306_I2C_PORT, SSD1306_SCL_PIN); }
static void SDA_Set(uint8_t v) { if (v) GPIO_SetBits(SSD1306_I2C_PORT, SSD1306_SDA_PIN);
                                 else   GPIO_ResetBits(SSD1306_I2C_PORT, SSD1306_SDA_PIN); }
static uint8_t SDA_Get(void)  { return GPIO_ReadInputDataBit(SSD1306_I2C_PORT, SSD1306_SDA_PIN); }

static void I2C_Start(void)
{
    SDA_Set(1); SCL_Set(1); I2C_Delay();
    SDA_Set(0); I2C_Delay();
    SCL_Set(0); I2C_Delay();
}

static void I2C_Stop(void)
{
    SCL_Set(0); SDA_Set(0); I2C_Delay();
    SCL_Set(1); I2C_Delay();
    SDA_Set(1); I2C_Delay();
}

/* 写一字节，返回 ACK（1=收到应答，0=无应答） */
static uint8_t I2C_WriteByte(uint8_t data)
{
    for (uint8_t i = 0; i < 8; i++)
    {
        SCL_Set(0); I2C_Delay();
        SDA_Set((data & 0x80) ? 1 : 0);
        data <<= 1;
        SCL_Set(1); I2C_Delay();
        SCL_Set(0);
    }
    /* 第 9 个时钟读 ACK：释放 SDA，SCL 拉高后读电平（低=ACK） */
    SDA_Set(1); I2C_Delay();
    SCL_Set(1); I2C_Delay();
    uint8_t ack = SDA_Get() ? 0 : 1;
    SCL_Set(0);
    return ack;
}

/* 写命令 / 写数据（SSD1306 控制字节 0x00=命令, 0x40=数据） */
static void SSD1306_WriteCmd(uint8_t cmd)
{
    I2C_Start();
    I2C_WriteByte(SSD1306_I2C_ADDR);
    I2C_WriteByte(0x00);
    I2C_WriteByte(cmd);
    I2C_Stop();
}

static void SSD1306_WriteData(uint8_t data)
{
    I2C_Start();
    I2C_WriteByte(SSD1306_I2C_ADDR);
    I2C_WriteByte(0x40);
    I2C_WriteByte(data);
    I2C_Stop();
}

/* ===================== 显存 + 字体 ===================== */
static uint8_t SSD1306_Buffer[SSD1306_WIDTH * SSD1306_PAGES];   // 1024 字节

/* 6x8 ASCII 字体（MSB=顶行），覆盖 32(空格) ~ 126(~) */
static const uint8_t Font6x8[95][6] = {
{0x00,0x00,0x00,0x00,0x00,0x00}, // 32 space
{0x00,0x00,0x00,0x2f,0x00,0x00}, // 33 !
{0x00,0x00,0x07,0x00,0x07,0x00}, // 34 "
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{0x00,0x02,0x01,0x02,0x04,0x02}, // 126 ~
};

/* ===================== 对外接口 ===================== */
void SSD1306_Init(void)
{
    GPIO_InitTypeDef gpio;
    RCC_APB2PeriphClockCmd(RCC_APB2Periph_GPIOB, ENABLE);
    gpio.GPIO_Pin   = SSD1306_SCL_PIN | SSD1306_SDA_PIN;
    gpio.GPIO_Mode  = GPIO_Mode_Out_OD;   // 开漏输出（靠模块板上拉电阻拉高）
    gpio.GPIO_Speed = GPIO_Speed_50MHz;
    GPIO_Init(SSD1306_I2C_PORT, &gpio);
    SCL_Set(1); SDA_Set(1);

    Delay_ms(100);

    /* 标准初始化序列（128x64） */
    SSD1306_WriteCmd(0xAE);               // 关闭显示
    SSD1306_WriteCmd(0xD5); SSD1306_WriteCmd(0x80);   // 设置时钟分频
    SSD1306_WriteCmd(0xA8); SSD1306_WriteCmd(0x3F);   // 多路复用 1/64
    SSD1306_WriteCmd(0xD3); SSD1306_WriteCmd(0x00);   // 显示偏移
    SSD1306_WriteCmd(0x40);               // 起始行 0
    SSD1306_WriteCmd(0x8D); SSD1306_WriteCmd(0x14);   // 开启电荷泵
    SSD1306_WriteCmd(0x20); SSD1306_WriteCmd(0x00);   // 水平地址模式
    SSD1306_WriteCmd(0xA1);               // 段重映射（左右）
    SSD1306_WriteCmd(0xC8);               // 列扫描方向（上下）
    SSD1306_WriteCmd(0xDA); SSD1306_WriteCmd(0x12);   // COM 引脚配置
    SSD1306_WriteCmd(0x81); SSD1306_WriteCmd(0xCF);   // 对比度
    SSD1306_WriteCmd(0xD9); SSD1306_WriteCmd(0xF1);   // 预充电
    SSD1306_WriteCmd(0xDB); SSD1306_WriteCmd(0x40);   // VCOMH
    SSD1306_WriteCmd(0xA6);               // 正常显示（非反色）
    SSD1306_WriteCmd(0xAF);               // 开启显示

    SSD1306_Clear();
    SSD1306_Update();
}

void SSD1306_Clear(void)
{
    memset(SSD1306_Buffer, 0, sizeof(SSD1306_Buffer));
}

void SSD1306_DrawString(uint8_t col, uint8_t page, const char *str)
{
    uint8_t x = col;
    if (page >= SSD1306_PAGES) return;

    while (*str && x < SSD1306_WIDTH)
    {
        char c = *str++;
        if (c < 32) c = 32;
        if (c > 126) c = 126;
        const uint8_t *g = Font6x8[c - 32];
        for (uint8_t i = 0; i < 6; i++)
        {
            if (x < SSD1306_WIDTH)
                SSD1306_Buffer[page * SSD1306_WIDTH + x] = g[i];
            x++;
        }
        if (x < SSD1306_WIDTH)            // 字符间留 1 像素空隙
            SSD1306_Buffer[page * SSD1306_WIDTH + x] = 0;
        x++;
    }
}

void SSD1306_Update(void)
{
    for (uint8_t page = 0; page < SSD1306_PAGES; page++)
    {
        SSD1306_WriteCmd(0xB0 + page);    // 设置页地址
        SSD1306_WriteCmd(0x00);           // 列地址低 4 位
        SSD1306_WriteCmd(0x10);           // 列地址高 4 位

        /* 一页 128 字节连续发送（一次 I2C 事务） */
        I2C_Start();
        I2C_WriteByte(SSD1306_I2C_ADDR);
        I2C_WriteByte(0x40);
        for (uint8_t col = 0; col < SSD1306_WIDTH; col++)
            I2C_WriteByte(SSD1306_Buffer[page * SSD1306_WIDTH + col]);
        I2C_Stop();
    }
}
